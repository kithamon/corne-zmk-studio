## config/west.yml
```yaml
manifest:
  remotes:
    - name: zmkfirmware
      url-base: https://github.com/zmkfirmware
    - name: kithamon
      url-base: https://github.com/kithamon
  projects:
    - name: zmk
      remote: zmkfirmware
      revision: v0.3.0
      import: app/west.yml
    - name: nice-view-gem
      remote: kithamon
      revision: inverted-fix
  self:
    path: config
```
